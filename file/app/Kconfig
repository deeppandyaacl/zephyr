## file/app/Kconfig
```kconfig
# SIBEL INC ("SIBEL HEALTH") CONFIDENTIAL
#
# Copyright 2018-2024 [Sibel Inc.], All Rights Reserved.
#
# NOTICE: All information contained herein is, and remains the property of SIBEL
# INC. The intellectual and technical concepts contained herein are proprietary
# to SIBEL INC and may be covered by U.S. and Foreign Patents, patents in
# process, and are protected by trade secret or copyright law. Dissemination of
# this information or reproduction of this material is strictly forbidden unless
# prior written permission is obtained from SIBEL INC. Access to the source code
# contained herein is hereby forbidden to anyone except current SIBEL INC
# employees, managers or contractors who have executed Confidentiality and
# Non-disclosure agreements explicitly covering such access.
# The copyright notice above does not evidence any actual or intended
# publication or disclosure of this source code, which includes information that
# is confidential and/or proprietary, and is a trade secret of SIBEL INC.
#
# ANY REPRODUCTION, MODIFICATION, DISTRIBUTION, PUBLIC PERFORMANCE, OR PUBLIC
# DISPLAY OF OR THROUGH USE OF THIS SOURCE CODE WITHOUT THE EXPRESS WRITTEN
# CONSENT OF COMPANY IS STRICTLY PROHIBITED, AND IN VIOLATION OF APPLICABLE
# LAWS AND INTERNATIONAL TREATIES. THE RECEIPT OR POSSESSION OF THIS SOURCE
# CODE AND/OR RELATED INFORMATION DOES NOT CONVEY OR IMPLY ANY RIGHTS TO
# REPRODUCE, DISCLOSE OR DISTRIBUTE ITS CONTENTS, OR TO MANUFACTURE, USE, OR
# SELL ANYTHING THAT IT MAY DESCRIBE, IN WHOLE OR IN PART.

menu "Zephyr"
rsource "Kconfig.btshell"
rsource "Kconfig.version"
rsource "Kconfig.audio"
rsource "Kconfig.segno"
source "Kconfig.zephyr"


config TEMP_STREAMING
	bool "Temperature Streaming"
	default n
    depends on TEMP_BLE_SERVICE && (MAX30205 || TMP119SH || AS6221) && SENSOR_STREAMING_APPLICATION
	help
	  This option is enabled to enable the streaming of temperature

config IMU_STREAMING
	bool "IMU Streaming"
	default n
    depends on IMU_BLE_SERVICE && (SH_LSM6DSL || SH_BMI323 || BMA456) && PIPES && SENSOR_STREAMING_APPLICATION
	help
	  This option is enabled to enable the streaming of temperature

config IMU_ACCL_ODR_STREAMING
	int "IMU sampling rate for streaming"
	default 400
    depends on IMU_STREAMING
	help
	  Sampling rate for streaming IMU in Hz

config ECG_STREAMING
	bool "ECG Streaming"
	default n
    depends on MAX30001
	help
	  This option is enabled to enable the streaming of ECG

config MIC_STREAMING
	bool "Microphone Streaming"
	default n
    depends on MIC_BLE_SERVICE && MICROPHONE && PIPES && SENSOR_STREAMING_APPLICATION
	help
	  This option is enabled to enable the streaming of Microphone

config BAROMETER_STREAMING
	bool "Barometer Streaming"
	default n
    depends on BARO_BLE_SERVICE && SH_BMP5 && PIPES && SENSOR_STREAMING_APPLICATION
	help
	  This option is enabled to enable the streaming of Barometer

config TEST_LITTLEFS
	bool "Test LittleFS"
	default n
    depends on MICRON_SPI_NAND
	help
	  This option is enabled to test the LittleFS multiple write/read
	  and multiple mount/unmount
	  
config TEST_LITTLEFS_MULTI_WRITE
	bool "Test LittleFS for multiple write"
	default n
    depends on MICRON_SPI_NAND
	help
	  This option is enabled to test the LittleFS single file multiple
	  chunk write and single read 
	  
config TEST_FLASH
	bool "Test Flash"
	default n
    depends on MICRON_SPI_NAND
	help
	  This option is enabled to test the flash multiple page write/read
	  in multiple blocks

config MAX30205_TEST
    bool "Test the temprature sensor module"
    depends on MAX30205
    help
       Set to enable the max30205 sensor test.
       
config LSM6DSL_TEST
    bool "Test the lsm6dsl sensor module"
    depends on SH_LSM6DSL
    help
       Set to enable the IMU sensor test.

config FACTORY_DATA_BLOCK
    bool "Enable the factory data block"
    default n
    help
        Set to enable the factory data block.

config CBOR_API
    bool "Enable the cbor APIs"
    default n
    depends on ZCBOR
    help
        Set to access the cbor APIs.

config FACTORY_DATA_BLOCK_TEST
    bool "Test the the factory data block"
	default n
    depends on FACTORY_DATA_BLOCK && CBOR_API
    help
       Set to display the factory data block.

config TEST_RAW_MIC_DATA
    bool "Test the microphone with Raw data"
	default n
    depends on MICROPHONE
    help
       Raw microphone data will come on serial terminal for 1 second.

config TEST_ENCODE_DECODE_DATA
    bool "Test the microphone with LC3 Compression and Decompression"
	default n
    depends on MICROPHONE
    help
       Mic Data after LC3 compression and decompression will come on serial terminal for 1 second.

config STREAM_CONN_INTERVAL_MIN
    int "Stream Connection Interval Min"
	default 12
    depends on BT
    help
       Stream connection interval minimum.

config STREAM_CONN_INTERVAL_MAX
    int "Stream Connection Interval Max"
	default 12
    depends on BT
    help
       Stream connection interval minimum.

config STREAM_SLAVE_LATENCY
    int "Slave latency for stream"
	default 0
    depends on BT
    help
       Slave latency for ble connection.

config MIC_STREAM_CONN_INTERVAL_MIN
    int "Stream with Mic enabled Connection Interval Min"
	default 12
    depends on BT
    help
       Stream connection with microphone enabled interval minimum.

config MIC_STREAM_CONN_INTERVAL_MAX
    int "Stream with Mic enabled Connection Interval Max"
	default 12
    depends on BT
    help
       Stream connection with microhponr enabled interval minimum.

config MIC_STREAM_SLAVE_LATENCY
    int "Slave latency for stream with Mic enabled"
	default 0
    depends on BT
    help
       Slave latency for ble connection with microphone enabled.

config IDLE_CONN_INTERVAL_MIN
    int "Idle stream Connection Interval Min"
	default 50
    depends on BT
    help
       Idle connection interval minimum.

config IDLE_CONN_INTERVAL_MAX
    int "Idle stream Connection Interval Max"
	default 70
    depends on BT
    help
       Idle connection interval minimum.

config IDLE_SLAVE_LATENCY
    int "Idle slave latency for Idle"
	default 1
    depends on BT
    help
       Slave latency for ble connection.

config SUPERVISION_TIMEOUT
    int "Supervision timeout"
	default 400
    depends on BT
    help
       Supervision timeout for ble connection.
# Kconfig File

config MEMFAULT_NVIC_INTERRUPTS_TO_COLLECT
    int "Number of NVIC interrupts to collect"
    default 64
    range 1 256
    help
      Set the number of interrupts to collect. If not set in prj.config, this will remain unused.

config MEMFAULT_METRICS_BATTERY_ENABLE
    bool "Enable battery metrics"
    default n
    help
      Enable or disable battery metrics collection. If not set, this will remain unused.

config MEMFAULT_METRICS_BATTERY_SOC_PCT_SCALE_VALUE
    int "State-of-charge percentage scale value"
    default 1
    range 1 100
    help
      Set the scale value for state-of-charge percentage resolution. If not set, this will remain unused.

config MEMFAULT_METRICS_HEARTBEAT_INTERVAL_SECS
    int "Heartbeat interval in seconds"
    default 30
    range 1 3600
    help
      Set the interval for heartbeat reporting in seconds. If not set, this will remain unused.

endmenu

module = APP
module-str = APP
source "subsys/logging/Kconfig.template.log_config"

rsource "../../sh_sdk_2_0/Kconfig"
```

## file/app/Kconfig.audio
```kconfig
# SIBEL INC ("SIBEL HEALTH") CONFIDENTIAL
#
# Copyright 2018-2024 [Sibel Inc.], All Rights Reserved.
#
# NOTICE: All information contained herein is, and remains the property of SIBEL
# INC. The intellectual and technical concepts contained herein are proprietary
# to SIBEL INC and may be covered by U.S. and Foreign Patents, patents in
# process, and are protected by trade secret or copyright law. Dissemination of
# this information or reproduction of this material is strictly forbidden unless
# prior written permission is obtained from SIBEL INC. Access to the source code
# contained herein is hereby forbidden to anyone except current SIBEL INC
# employees, managers or contractors who have executed Confidentiality and
# Non-disclosure agreements explicitly covering such access.
# The copyright notice above does not evidence any actual or intended
# publication or disclosure of this source code, which includes information that
# is confidential and/or proprietary, and is a trade secret of SIBEL INC.
#
# ANY REPRODUCTION, MODIFICATION, DISTRIBUTION, PUBLIC PERFORMANCE, OR PUBLIC
# DISPLAY OF OR THROUGH USE OF THIS SOURCE CODE WITHOUT THE EXPRESS WRITTEN
# CONSENT OF COMPANY IS STRICTLY PROHIBITED, AND IN VIOLATION OF APPLICABLE
# LAWS AND INTERNATIONAL TREATIES. THE RECEIPT OR POSSESSION OF THIS SOURCE
# CODE AND/OR RELATED INFORMATION DOES NOT CONVEY OR IMPLY ANY RIGHTS TO
# REPRODUCE, DISCLOSE OR DISTRIBUTE ITS CONTENTS, OR TO MANUFACTURE, USE, OR
# SELL ANYTHING THAT IT MAY DESCRIBE, IN WHOLE OR IN PART.

config SH_LC3_CODEC
	bool "LC3_CODEC Support"
	default n
	help
	  This option enables the LC3 Codec library support

menu "Audio"

choice AUDIO_FRAME_DURATION
	prompt "Select frame duration - 7.5 ms frame duration is not tested"
	default AUDIO_FRAME_DURATION_10_MS
	help
	  LC3 supports frame duration of 7.5 and 10 ms.

config AUDIO_FRAME_DURATION_7_5_MS
	bool "7.5 ms"

config AUDIO_FRAME_DURATION_10_MS
	bool "10 ms"
endchoice

config AUDIO_FRAME_DURATION_US
	int
	default 7500 if AUDIO_FRAME_DURATION_7_5_MS
	default 10000 if AUDIO_FRAME_DURATION_10_MS
	help
	  Audio frame duration in µs.

config AUDIO_MIN_PRES_DLY_US
	int "The minimum presentation delay"
	default 4000
	help
	  The minimum presentation delay in micro seconds determined by
	  the audio system processing and the minimum buffering.

config AUDIO_MAX_PRES_DLY_US
	int "The maximum presentation delay"
	default 60000
	help
	  The maximum presentation delay in micro seconds.

choice AUDIO_SAMPLE_RATE
	prompt "Audio sample rate"
	default AUDIO_SAMPLE_RATE_16000_HZ 
	help
	  This will be selected based on the BAP settings.

config AUDIO_SAMPLE_RATE_16000_HZ
	bool "16 kHz"
	help
	  Sample rate of 16kHz.

config AUDIO_SAMPLE_RATE_24000_HZ
	bool "24 kHz"
	help
	  Sample rate of 24kHz.

config AUDIO_SAMPLE_RATE_48000_HZ
	bool "48 kHz"
	help
	  Sample rate of 48kHz.
endchoice

config AUDIO_SAMPLE_RATE_HZ
	int
	default 16000 if AUDIO_SAMPLE_RATE_16000_HZ
	default 24000 if AUDIO_SAMPLE_RATE_24000_HZ
	default 48000 if AUDIO_SAMPLE_RATE_48000_HZ
	help
	  I2S supports 16, 24, and 48 kHz sample rates for both input and output.
	  USB supports only 48 kHz for input.

choice AUDIO_BIT_DEPTH
	prompt "Audio bit depth"
	default AUDIO_BIT_DEPTH_16
	help
	  Select the bit depth for audio.

config AUDIO_BIT_DEPTH_16
	bool "16 bit audio"

config AUDIO_BIT_DEPTH_32
	bool "32 bit audio"
endchoice

config AUDIO_BIT_DEPTH_BITS
	int
	default 16 if AUDIO_BIT_DEPTH_16
	default 32 if AUDIO_BIT_DEPTH_32
	help
	  Bit depth of one sample in storage.

config AUDIO_BIT_DEPTH_OCTETS
	int
	default 2 if AUDIO_BIT_DEPTH_16
	default 4 if AUDIO_BIT_DEPTH_32
	help
	  Bit depth of one sample in storage given in octets.

config AUDIO_MIN_PRES_DLY_US
	int "The minimum presentation delay"
	default 4000
	help
	  The minimum allowable presentation delay in microseconds.
	  This needs to allow time for decoding and internal routing.
	  For 48kHz sampling rate and 96kbps bitrate this is about 4000 us.

config AUDIO_MAX_PRES_DLY_US
	int "The maximum presentation delay"
	default 60000
	help
	  The maximum allowable presentation delay in microseconds.
	  Increasing this will also increase the FIFO buffers to allow buffering.

#----------------------------------------------------------------------------#
menu "SW Codec"

choice SW_CODEC_DEFAULT
	prompt "Starting SW codec"
	default SW_CODEC_LC3
	depends on MICROPHONE
	help
	  Select the default codec to use on start up.

config SW_CODEC_LC3
	bool "LC3"
	select SW_CODEC_LC3_T2_SH_SOFTWARE
	depends on MICROPHONE
	help
	  LC3 is the mandatory codec for LE Audio.

# Leave room for other codecs
endchoice

config SW_CODEC_PLC_DISABLED
	bool "Skip PLC on a bad frame and fill the output buffer(s) with zeros instead"
	default n
	select LC3_PLC_DISABLED

menu "LC3"
visible if SW_CODEC_LC3

config LC3_BITRATE_MAX
	int "Max bitrate for LC3"
	default 124000

config LC3_BITRATE_MIN
	int "Min bitrate for LC3"
	default 32000

config LC3_BITRATE
	int
	range LC3_BITRATE_MIN LC3_BITRATE_MAX
	default 32000
	help
	  Configure Bitrate for encoding

osource "../../nrfxlib/lc3/Kconfig"

endmenu # LC3
endmenu # SW Codec

#----------------------------------------------------------------------------#
menu "Stream"

config BUF_BLE_RX_PACKET_NUM
	int
	default 5
	range 2 5
	help
	  Value can be adjusted to affect the overall latency.
	  This adjusts the number packets in the BLE FIFO RX buffer,
	  which is where the main latency resides. A low value will decrease
	  latency and reduce stability, and vice-versa.
	  Two is recommended minimum to reduce the likelyhood of audio
	  gaps due to BLE retransmits.

config STREAM_BIDIRECTIONAL
	depends on TRANSPORT_CIS
	bool "Bidirectional stream"
	default n
	help
	  Bidirectional stream enables encoder and decoder on both sides,
	  and one device can both send and receive audio.

config WALKIE_TALKIE_DEMO
	select STREAM_BIDIRECTIONAL
	bool "Walkie talkie demo"
	default n
	help
	  The walkie talkie demo will set up a bidirectional stream using PDM
	  microphones on each side.

config MONO_TO_ALL_RECEIVERS
	bool "Send mono (first/left channel) to all receivers"
	default y if BT_BAP_UNICAST_CLIENT_ASE_SNK_COUNT = 1
	default y if BT_BAP_BROADCAST_SRC_STREAM_COUNT = 1
	default n
	help
	  With this flag set, the gateway will encode and send the same (first/left)
	  channel on all ISO channels.

endmenu # Stream


endmenu # Audio
```
