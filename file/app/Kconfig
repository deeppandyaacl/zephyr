## file/app/Kconfig.btshell
```kconfig
# SIBEL INC ("SIBEL HEALTH") CONFIDENTIAL
#
# Copyright 2018-2024 [Sibel Inc.], All Rights Reserved.
#
# NOTICE: All information contained herein is, and remains the property of SIBEL
# INC. The intellectual and technical concepts contained herein are proprietary
# to SIBEL INC and may be covered by U.S. and Foreign Patents, patents in
# process, and are protected by trade secret or copyright law. Dissemination of
# this information or reproduction of this material is strictly forbidden unless
# prior written permission is obtained from SIBEL INC. Access to the source code
# contained herein is hereby forbidden to anyone except current SIBEL INC
# employees, managers or contractors who have executed Confidentiality and
# Non-disclosure agreements explicitly covering such access.
# The copyright notice above does not evidence any actual or intended
# publication or disclosure of this source code, which includes information that
# is confidential and/or proprietary, and is a trade secret of SIBEL INC.
#
# ANY REPRODUCTION, MODIFICATION, DISTRIBUTION, PUBLIC PERFORMANCE, OR PUBLIC
# DISPLAY OF OR THROUGH USE OF THIS SOURCE CODE WITHOUT THE EXPRESS WRITTEN
# CONSENT OF COMPANY IS STRICTLY PROHIBITED, AND IN VIOLATION OF APPLICABLE
# LAWS AND INTERNATIONAL TREATIES. THE RECEIPT OR POSSESSION OF THIS SOURCE
# CODE AND/OR RELATED INFORMATION DOES NOT CONVEY OR IMPLY ANY RIGHTS TO
# REPRODUCE, DISCLOSE OR DISTRIBUTE ITS CONTENTS, OR TO MANUFACTURE, USE, OR
# SELL ANYTHING THAT IT MAY DESCRIBE, IN WHOLE OR IN PART.

menuconfig SHELL_BT
	bool
	prompt "Shell Bluetooth transport"
    default y
	depends on BT
	select SHELL
	select BT_NUS
	select RING_BUFFER
	help
	  Enable shell BT NUS transport.

if SHELL_BT

config SHELL_PROMPT_BT
	string "Displayed prompt name"
	default "sh:~$ "
	help
	  Displayed prompt name for shell over bluetooth. If prompt is set, the shell will
	  send two newlines during initialization.

config SHELL_BT_TX_RING_BUFFER_SIZE
	int "Set TX ring buffer size"
	default 32
	help
	  Should be increased if long MTU is used since it allows to transfer
	  data in bigger chunks (up to size of the ring buffer).

config SHELL_BT_RX_RING_BUFFER_SIZE
	int "Set RX ring buffer size"
	default 32
	help
	  RX ring buffer size impacts accepted latency of handling incoming
	  bytes by shell. If shell input is coming from the keyboard then it is
	  usually enough if ring buffer is few bytes (more than one due to
	  escape sequences). However, if bulk data is transferred it may be

choice
	prompt "Initial log level limit"
	default SHELL_BT_INIT_LOG_LEVEL_WRN

config SHELL_BT_INIT_LOG_LEVEL_DEFAULT
	bool "System limit (LOG_MAX_LEVEL)"

config SHELL_BT_INIT_LOG_LEVEL_DBG
	bool "Debug"

config SHELL_BT_INIT_LOG_LEVEL_INF
	bool "Info"

config SHELL_BT_INIT_LOG_LEVEL_WRN
	bool "Warning"

config SHELL_BT_INIT_LOG_LEVEL_ERR
	bool "Error"

config SHELL_BT_INIT_LOG_LEVEL_NONE
	bool "None"
endchoice

config SHELL_BT_INIT_LOG_LEVEL
	int
	default 0 if SHELL_BT_INIT_LOG_LEVEL_NONE
	default 1 if SHELL_BT_INIT_LOG_LEVEL_ERR
	default 2 if SHELL_BT_INIT_LOG_LEVEL_WRN
	default 3 if SHELL_BT_INIT_LOG_LEVEL_INF
	default 4 if SHELL_BT_INIT_LOG_LEVEL_DBG
	default 5 if SHELL_BT_INIT_LOG_LEVEL_DEFAULT

endif #SHELL_BT
```

## file/app/Kconfig.segno
```kconfig
# SIBEL INC ("SIBEL HEALTH") CONFIDENTIAL
#
# Copyright 2018-2021 [Sibel Inc.], All Rights Reserved.
#
# NOTICE: All information contained herein is, and remains the property of SIBEL
# INC. The intellectual and technical concepts contained herein are proprietary
# to SIBEL INC and may be covered by U.S. and Foreign Patents, patents in
# process, and are protected by trade secret or copyright law. Dissemination of
# this information or reproduction of this material is strictly forbidden unless
# prior written permission is obtained from SIBEL INC. Access to the source code
# contained herein is hereby forbidden to anyone except current SIBEL INC
# employees, managers or contractors who have executed Confidentiality and
# Non-disclosure agreements explicitly covering such access.
# The copyright notice above does not evidence any actual or intended
# publication or disclosure of this source code, which includes information that
# is confidential and/or proprietary, and is a trade secret of SIBEL INC.
#
# ANY REPRODUCTION, MODIFICATION, DISTRIBUTION, PUBLIC PERFORMANCE, OR PUBLIC
# DISPLAY OF OR THROUGH USE OF THIS SOURCE CODE WITHOUT THE EXPRESS WRITTEN
# CONSENT OF COMPANY IS STRICTLY PROHIBITED, AND IN VIOLATION OF APPLICABLE
# LAWS AND INTERNATIONAL TREATIES. THE RECEIPT OR POSSESSION OF THIS SOURCE
# CODE AND/OR RELATED INFORMATION DOES NOT CONVEY OR IMPLY ANY RIGHTS TO
# REPRODUCE, DISCLOSE OR DISTRIBUTE ITS CONTENTS, OR TO MANUFACTURE, USE, OR
# SELL ANYTHING THAT IT MAY DESCRIBE, IN WHOLE OR IN PART.

menu "Segno"

config SEGNO_LIBRARY
    bool "Enable the segno library"
    default n
    help
        Set to enable the segno library.

config SEGNO_SCRATCH_PROGRAM
    bool "Enable the segno scratch program"
    default n
    depends on SEGNO_LIBRARY
    help
        Set to enable the scratch program

config SEGNO_WEAR_DETECT_PROGRAM
    bool "Enable the segno wear detection program"
    default n
    depends on SEGNO_LIBRARY
    help
        Set to enable the wear detection program

config SEGNO_ACTIVITY_DETECT_PROGRAM
    bool "Enable the segno activity detection program"
    default n
    depends on SEGNO_LIBRARY
    help
        Set to enable the activity detection program

config SEGNO_ANGLE_DETECT_PROGRAM
    bool "Enable the segno angle detection program"
    default n
    depends on SEGNO_LIBRARY
    help
        Set to enable the angle detection program

config SEGNO_LEAD_ON_OFF
    bool "Enable the lead on and off"
    default n
    depends on SEGNO_LIBRARY
    help
        Set to enable the lead on/off support from segno

endmenu
```

## file/app/Kconfig.version
```kconfig
# SIBEL INC ("SIBEL HEALTH") CONFIDENTIAL
#
# Copyright 2018-2024 [Sibel Inc.], All Rights Reserved.
#
# NOTICE: All information contained herein is, and remains the property of SIBEL
# INC. The intellectual and technical concepts contained herein are proprietary
# to SIBEL INC and may be covered by U.S. and Foreign Patents, patents in
# process, and are protected by trade secret or copyright law. Dissemination of
# this information or reproduction of this material is strictly forbidden unless
# prior written permission is obtained from SIBEL INC. Access to the source code
# contained herein is hereby forbidden to anyone except current SIBEL INC
# employees, managers or contractors who have executed Confidentiality and
# Non-disclosure agreements explicitly covering such access.
# The copyright notice above does not evidence any actual or intended
# publication or disclosure of this source code, which includes information that
# is confidential and/or proprietary, and is a trade secret of SIBEL INC.
#
# ANY REPRODUCTION, MODIFICATION, DISTRIBUTION, PUBLIC PERFORMANCE, OR PUBLIC
# DISPLAY OF OR THROUGH USE OF THIS SOURCE CODE WITHOUT THE EXPRESS WRITTEN
# CONSENT OF COMPANY IS STRICTLY PROHIBITED, AND IN VIOLATION OF APPLICABLE
# LAWS AND INTERNATIONAL TREATIES. THE RECEIPT OR POSSESSION OF THIS SOURCE
# CODE AND/OR RELATED INFORMATION DOES NOT CONVEY OR IMPLY ANY RIGHTS TO
# REPRODUCE, DISCLOSE OR DISTRIBUTE ITS CONTENTS, OR TO MANUFACTURE, USE, OR
# SELL ANYTHING THAT IT MAY DESCRIBE, IN WHOLE OR IN PART.

menu "App Version"

config APP_VERSION_MAJOR
	int "Major verison number"
	default 0

config APP_VERSION_MINOR
	int "Minor verison number"
	default 0

config APP_VERSION_PATCH
	int "Patch verison number"
	default 0

config APP_VERSION_COMMIT
	int "Commit verison number"
	default 0

config APP_VERSION_HASH
	string "Version hash provided by Git"
	default ""

config APP_VERSION
	string "Full version string provided by Git"
	default "1.0.0"

config APP_STATUS
    string "App status checked based on the modifications."
    default ""

endmenu
```

## file/build/Kconfig/Kconfig.modules
```kconfig
menu "Anne-Aria (/home/deep/klokwork/my-workspace/Anne-Aria)"
osource "/home/deep/klokwork/my-workspace/sh_sdk_2_0/Kconfig"
config ZEPHYR_ANNE_ARIA_MODULE
	bool
	default y
endmenu
menu "memfault-firmware-sdk (/home/deep/klokwork/my-workspace/modules/lib/memfault-firmware-sdk)"
osource "/home/deep/klokwork/my-workspace/modules/lib/memfault-firmware-sdk/ports/zephyr/Kconfig"
config ZEPHYR_MEMFAULT_FIRMWARE_SDK_MODULE
	bool
	default y
endmenu
menu "nrf (/home/deep/klokwork/my-workspace/nrf)"
osource "/home/deep/klokwork/my-workspace/nrf/Kconfig.nrf"
config ZEPHYR_NRF_MODULE
	bool
	default y
endmenu
menu "cjson (/home/deep/klokwork/my-workspace/modules/lib/cjson)"
osource "$(ZEPHYR_CJSON_KCONFIG)"
config ZEPHYR_CJSON_MODULE
	bool
	default y
endmenu
config ZEPHYR_TINYCRYPT_MODULE
   bool
   default y
menu "mcuboot (/home/deep/klokwork/my-workspace/bootloader/mcuboot)"
osource "$(ZEPHYR_MCUBOOT_KCONFIG)"
config ZEPHYR_MCUBOOT_MODULE
	bool
	default y
endmenu
menu "mbedtls (/home/deep/klokwork/my-workspace/modules/crypto/mbedtls)"
osource "$(ZEPHYR_MBEDTLS_KCONFIG)"
config ZEPHYR_MBEDTLS_MODULE
	bool
	default y
endmenu
config ZEPHYR_LIBMETAL_MODULE
   bool
   default y
config ZEPHYR_OPEN_AMP_MODULE
   bool
   default y
menu "cmsis (/home/deep/klokwork/my-workspace/modules/hal/cmsis)"
osource "$(ZEPHYR_CMSIS_KCONFIG)"
config ZEPHYR_CMSIS_MODULE
	bool
	default y
endmenu
menu "hal_nordic (/home/deep/klokwork/my-workspace/modules/hal/nordic)"
osource "$(ZEPHYR_HAL_NORDIC_KCONFIG)"
config ZEPHYR_HAL_NORDIC_MODULE
	bool
	default y
endmenu
menu "liblc3 (/home/deep/klokwork/my-workspace/modules/lib/liblc3)"
osource "$(ZEPHYR_LIBLC3_KCONFIG)"
config ZEPHYR_LIBLC3_MODULE
	bool
	default y
endmenu
menu "littlefs (/home/deep/klokwork/my-workspace/modules/fs/littlefs)"
osource "$(ZEPHYR_LITTLEFS_KCONFIG)"
config ZEPHYR_LITTLEFS_MODULE
	bool
	default y
endmenu
menu "segger (/home/deep/klokwork/my-workspace/modules/debug/segger)"
osource "$(ZEPHYR_SEGGER_KCONFIG)"
config ZEPHYR_SEGGER_MODULE
	bool
	default y
endmenu
menu "zcbor (/home/deep/klokwork/my-workspace/modules/lib/zcbor)"
osource "$(ZEPHYR_ZCBOR_KCONFIG)"
config ZEPHYR_ZCBOR_MODULE
	bool
	default y
endmenu
menu "nrfxlib (/home/deep/klokwork/my-workspace/nrfxlib)"
osource "/home/deep/klokwork/my-workspace/nrfxlib/Kconfig.nrfxlib"
config ZEPHYR_NRFXLIB_MODULE
	bool
	default y
endmenu
```

## file/build/hci_ipc/b0n/Kconfig/Kconfig.shield.defconfig
```kconfig
osource "/home/deep/klokwork/my-workspace/Anne-Aria/../boards/shields/*/Kconfig.defconfig"
osource "/home/deep/klokwork/my-workspace/nrf/boards/shields/*/Kconfig.defconfig"
```

## file/build/mcuboot/Kconfig/Kconfig.shield
```kconfig
osource "/home/deep/klokwork/my-workspace/Anne-Aria/../boards/shields/*/Kconfig.shield"
osource "/home/deep/klokwork/my-workspace/nrf/boards/shields/*/Kconfig.shield"
```

## file/build/mcuboot/Kconfig/Kconfig.sysbuild.modules
```kconfig
menu "nrf (/home/deep/klokwork/my-workspace/nrf)"
osource "/home/deep/klokwork/my-workspace/nrf/sysbuild/Kconfig.sysbuild"
config ZEPHYR_NRF_MODULE
	bool
	default y
endmenu
```

## file/west.yml
```yaml
# Copyright (c) 2021 Nordic Semiconductor ASA
# SPDX-License-Identifier: Apache-2.0

manifest:
  remotes:
  - name: ncs
    url-base: https://github.com/nrfconnect
  - name: zephyrproject-rtos
    url-base: https://github.com/zephyrproject-rtos
  - name: memfault
    url-base: https://github.com/memfault
  - name: sibelhealth
    url-base: https://github.com/sibelhealth
  projects:
  - name: memfault-firmware-sdk
    remote: memfault
    revision: 6652e81ea85675d236b5485874fa457335ba7918
    path: modules/lib/memfault-firmware-sdk
  - name: sh_sdk_2.0
    remote: sibelhealth
    path: sh_sdk_2_0
    revision: 341d78dd3156b9fd28acfebc4a137ba3d7b6ce32 #develop
  - name: sh_zephyr_boards
    remote: sibelhealth
    path: boards
    revision: b405484ce005933a041d92d695b0d5b4b0fcc02e
  - name: sdk-nrf
    remote: ncs
    path: nrf
    revision: eef645c4a31201df353fdff5447262d7675fa1c1 #v2.6.1
    clone-depth: 1
  - name: sdk-nrfxlib
    remote: ncs
    path: nrfxlib
    revision: 9adb63b61a67ab0df6cd516870cae7b604f01af1 #v2.6
    clone-depth: 1
  - name: sdk-cjson
    remote: ncs
    revision: c6af068b7f05207b28d68880740e4b9ec1e4b50a
    path: modules/lib/cjson
  - name: tinycrypt
    remote: zephyrproject-rtos
    revision: 3e9a49d2672ec01435ffbf0d788db6d95ef28de0
    path: modules/crypto/tinycrypt
    groups:
    - crypto
  - name: sdk-mcuboot
    remote: ncs
    revision: 3c2f2ff12bc20625cd65730b6036d061de4da5f7 #v2.0.99-ncs1-branch 
    path: bootloader/mcuboot
  - name: sdk-mbedtls
    remote: ncs
    revision: 9beb52e67835a17368616b27700270b3eb99e4ca #v3.5.2-ncs2
    path: modules/crypto/mbedtls
  - name: libmetal
    remote: zephyrproject-rtos
    revision: b91611a6f47dd29fb24c46e5621e797557f80ec6
    path: modules/hal/libmetal
    groups:
    - hal
  - name: open-amp
    remote: zephyrproject-rtos
    revision: 42b7c577714b8f22ce82a901e19c1814af4609a8
    path: modules/lib/open-amp
  - name: sdk-zephyr
    remote: ncs
    path: zephyr
    revision: 3758bcbfa5cd749d977e2600b6687104b8948243 #3.5.99
    import:
      # By using name-allowlist we can clone only the modules that are
      # strictly needed by the application.
      name-allowlist:
      - cmsis # required by the ARM port
      - hal_nordic # required by the nordic board
      - littlefs
      - segger
      - zcbor
      - liblc3
  - name: segno
    remote: sibelhealth
    path: signal
    revision: 4d7acfd0d97441279be2e9f8e488bbfdde3c594b

  self:
    path: Anne-Aria
```
